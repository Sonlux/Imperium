## esp32-cam-node/sdkconfig.defaults
```kconfig
# ESP32-CAM sdkconfig.defaults
# Flash
CONFIG_ESPTOOLPY_FLASHSIZE_4MB=y
CONFIG_ESPTOOLPY_FLASHSIZE="4MB"

# Partition table
CONFIG_PARTITION_TABLE_CUSTOM=y
CONFIG_PARTITION_TABLE_CUSTOM_FILENAME="partitions.csv"
CONFIG_PARTITION_TABLE_FILENAME="partitions.csv"

# Camera
CONFIG_CAMERA_TASK_STACK_SIZE=4096
CONFIG_ESP32_SPIRAM_SUPPORT=y
CONFIG_SPIRAM=y
CONFIG_SPIRAM_USE_MALLOC=y

# WiFi
CONFIG_ESP_WIFI_SOFTAP_SUPPORT=y
```

## esp32-mhz19-node/sdkconfig.defaults
```kconfig
# ESP32 MH-Z19 Node Default Configuration

# WiFi Configuration
CONFIG_ESP_WIFI_SSID=""
CONFIG_ESP_WIFI_PASSWORD=""
CONFIG_ESP_MAXIMUM_RETRY=5

# MQTT Configuration
CONFIG_BROKER_URL="mqtt://192.168.1.100"

# System Configuration
CONFIG_FREERTOS_HZ=1000
CONFIG_ESP_TASK_WDT=y
CONFIG_ESP_TASK_WDT_TIMEOUT_S=10

# UART Configuration
CONFIG_UART_ISR_IN_IRAM=y

# Logging
CONFIG_LOG_DEFAULT_LEVEL_INFO=y
CONFIG_LOG_MAXIMUM_LEVEL_INFO=y

# Partition Table
CONFIG_PARTITION_TABLE_SINGLE_APP=y

# Stack Sizes
CONFIG_ESP_MAIN_TASK_STACK_SIZE=4096
CONFIG_MQTT_TASK_STACK_SIZE=6144
```
